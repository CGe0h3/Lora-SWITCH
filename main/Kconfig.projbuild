## main/Kconfig.projbuild
```kconfig
menu "Heltec multi-boot menu"

    choice MB_BOARD
        prompt "Board"
        default MB_BOARD_V4
        config MB_BOARD_V4
            bool "Heltec WiFi LoRa 32 V4 (ESP32-S3R2)"
        config MB_BOARD_V4_R8
            bool "Heltec WiFi LoRa 32 V4-R8 (ESP32-S3R8)"
    endchoice

    config MB_AUTOBOOT_SECONDS
        int "Seconds before booting the last firmware automatically"
        range 0 60
        default 5

    config MB_LONG_PRESS_MS
        int "Long press (ms) on PRG to start the selected firmware"
        default 700

endmenu
```

## sdkconfig.defaults
```kconfig
CONFIG_IDF_TARGET="esp32s3"
CONFIG_ESPTOOLPY_FLASHSIZE_16MB=y
CONFIG_ESPTOOLPY_FLASHMODE_DIO=y
CONFIG_ESPTOOLPY_FLASHFREQ_80M=y
CONFIG_PARTITION_TABLE_CUSTOM=y
CONFIG_PARTITION_TABLE_CUSTOM_FILENAME="partitions/menu.csv"
CONFIG_PARTITION_TABLE_OFFSET=0x8000
CONFIG_PARTITION_TABLE_MD5=y

# Bootloader: keep the stock behaviour, our hook only swaps the table
CONFIG_BOOTLOADER_LOG_LEVEL_INFO=y
CONFIG_BOOTLOADER_APP_ROLLBACK_ENABLE=n
CONFIG_BOOTLOADER_SKIP_VALIDATE_IN_DEEP_SLEEP=n
CONFIG_BOOTLOADER_FACTORY_RESET=n

# Menu app: small and quiet
CONFIG_COMPILER_OPTIMIZATION_SIZE=y
CONFIG_ESP_CONSOLE_USB_SERIAL_JTAG=y
CONFIG_LOG_DEFAULT_LEVEL_INFO=y
```
